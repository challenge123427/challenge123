## CMakeLists.txt
```
cmake_minimum_required(VERSION 3.20.0)
set(BOARD native_posix CACHE STRING "Board to build for")
find_package(Zephyr REQUIRED HINTS $ENV{ZEPHYR_BASE})
project(vitalink)
target_sources(app PRIVATE
  src/main.c
  src/sensors/sensor_driver.c
  src/ai/edge_ai.c
  src/comm/secure_comm.c
  src/power/power_mgmt.c
  src/storage/storage.c
  src/digital_twin/dt_sync.c
  src/alert/alert_manager.c
)
target_include_directories(app PRIVATE include)
```

## prj.conf
```kconfig
CONFIG_MAIN_STACK_SIZE=8192
CONFIG_SYS_CLOCK_EXISTS=y
# Enable POSIX/native support for host testing
CONFIG_NATIVE_POSIX=y
# Mock sensors for host testing
CONFIG_VITALINK_MOCK_SENSORS=y
# Enable networking features if available
CONFIG_NET_IPV4=y
```

## src/main.c
```c
#include <zephyr.h>
#include <sys/printk.h>
#include "vitalink.h"
#include "sensors/sensor_driver.h"
#include "ai/edge_ai.h"
#include "storage/storage.h"
#include "digital_twin/dt_sync.h"
#include "comm/secure_comm.h"
#include "power/power_mgmt.h"
#include "alert/alert_manager.h"

void sample_and_process(void)
{
    vl_sample_t s;
    if (!sensor_read_all(&s)) {
        printk("Sensor read failed\n");
        return;
    }
    // Local storage
    storage_append_sample(&s);
    // On-device inference
    ai_result_t res = ai_analyze_sample(&s);
    // Risk scoring & alerts
    if (res.risk_score > 0.7f) {
        alert_trigger_local(res.risk_score, res.primary_reason);
    }
    // Digital twin enqueue
    dt_enqueue_sample(&s, &res);
}

void comm_task(void)
{
    while (1) {
        // Try connect and sync batched deltas
        if (secure_comm_is_connected()) {
            // Mutual auth + send
            dt_sync_flush();
        } else {
            // low-power wait until next attempt
        }
        k_sleep(K_SECONDS(30));
    }
}

void main(void)
{
    printk("VitaLink starting\n");
    power_init();
    sensors_init();
    ai_init();
    storage_init();
    dt_init();
    secure_comm_init();
    alert_init();

    // Periodic sampling thread
    while (1) {
        sample_and_process();
        // Adaptive sampling based on power manager
        k_sleep(K_MSEC(power_get_sampling_interval_ms()));
    }
}
```

## include/vitalink.h
```c
#ifndef VITALINK_H
#define VITALINK_H

#include <stdint.h>
#include <stdbool.h>

#define VL_MAX_PAYLOAD 1024
#define VL_TIMESTAMP() (uint64_t)k_uptime_get()

typedef struct {
	// core vitals
	uint16_t heart_rate;     // bpm
	uint8_t spo2;            // %
	float skin_temp_c;       // C
	// environment
	float ambient_temp_c;
	float humidity_pct;
	float air_quality_index;
	float gas_ppm;
	float vibration_m_s2;
	float noise_db;
	// motion / posture
	int16_t accel_x, accel_y, accel_z;
	uint64_t timestamp_ms;
} vl_sample_t;

typedef struct {
	uint8_t device_id[16];
	uint32_t seq_num;
} vl_meta_t;

#endif // VITALINK_H
```
